## br2-external/Config.in
```kconfig
menu "PICO-8 Console"

source "$BR2_EXTERNAL_PICOOS_PATH/package/picoctrl-system/Config.in"

endmenu
```

## br2-external/package/picoctrl-system/Config.in
```kconfig
config BR2_PACKAGE_PICOCTRL_SYSTEM
	bool "picoctrl-system"
	depends on BR2_PACKAGE_HOST_GO_TARGET_ARCH_SUPPORTS
	select BR2_PACKAGE_HOST_GO
	help
	  Build and install the privileged PicoCtrl hardware shim for PicoOS.

	  The picoctrl source checkout must be beside the picoos checkout, in a
	  sibling directory named picoctrl.
```
